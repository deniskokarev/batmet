## zfirm/boards/arm/stm32f3_batmet/Kconfig.board
```kconfig
config BOARD_STM32F3_BATMET
	bool "STM32F3BATMET Development Board"
	depends on CONFIG_SOC_SERIES_STM32F3X
```

## zfirm/boards/arm/stm32f3_batmet/Kconfig.defconfig
```kconfig
if HAS_STM32CUBE

    config USE_STM32_HAL_OPAMP
        default y

    config USE_STM32_HAL_GPIO
        default y

endif # HAS_STM32CUBE
```

## zfirm/boards/arm/stm32f3_batmet/stm32f3_batmet_defconfig
```kconfig
# SPDX-License-Identifier: Apache-2.0

CONFIG_SOC_SERIES_STM32F3X=y
CONFIG_SOC_STM32F334X8=y

# for some reason MPU doesn't get enabled on the board
# by Kconfig. Disabling explicitly to avoid compilation warnings
CONFIG_ARM_MPU=n
CONFIG_HW_STACK_PROTECTION=n

# enable uart driver
CONFIG_SERIAL=y
CONFIG_UART_INTERRUPT_DRIVEN=y

# enable console
CONFIG_CONSOLE=y
CONFIG_UART_CONSOLE=y

# enable GPIO
CONFIG_GPIO=y

# Enable Clocks
CONFIG_CLOCK_CONTROL=y

# enable pin controller
CONFIG_PINCTRL=y
```
